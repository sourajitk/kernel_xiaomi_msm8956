// SPDX-License-Identifier: BSD-3-Clause
/*
 * Copyright (C) 2021 Sourajit Karmakar <sourajit.karmakar@gmail.com>
 */

&pmi8950_charger {
	qcom,iterm-ma = <150>;
	qcom,float-voltage-mv = <4400>;
	qcom,thermal-mitigation = <2000 1500 700 600 0>;
	/delete-property/ qcom,parallel-usb-min-current-ma;
	/delete-property/ qcom,parallel-usb-9v-min-current-ma;
	/delete-property/ qcom,parallel-allowed-lowering-ma;
	qcom,fastchg-current-comp = <900>;
	qcom,float-voltage-comp = <11>;
};

&pmi8950_fg {
	qcom,resume-soc = <99>;
	qcom,resume-soc-raw = <254>;
	qcom,fg-delta-soc = <1>;
	qcom,vbat-estimate-diff-mv = <100>;
	qcom,fg-iterm-ma = <200>;
	qcom,fg-chg-iterm-ma = <150>;
	qcom,fg-cutoff-voltage-mv = <3400>;
	qcom,cold-bat-decidegc = <0>;
	qcom,cool-bat-decidegc = <100>;
	qcom,warm-bat-decidegc = <450>;
	qcom,hot-bat-decidegc = <540>;
	qcom,cold-hot-jeita-hysteresis = <0 10>;
	qcom,thermal-coefficients = [67 85 FC 4A E0 3D];
};

&pmi8950_pwm {
	status = "ok";
	qcom,period = <4000000>;
	qcom,mode-select = <0>;
	qcom,lpg-dtest-line = <1>;
	qcom,dtest-output = <1>;

	qcom,pwm {
		qcom,duty = <2000000>;
		label = "pwm";
	};
};
