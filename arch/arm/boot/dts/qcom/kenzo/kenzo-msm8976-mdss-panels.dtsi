// SPDX-License-Identifier: BSD-3-Clause
/*
 * Copyright (C) 2021 Sourajit Karmakar <sourajit.karmakar@gmail.com>
 */

#include "display/dsi-panel-tianma-nt35596-1080p-video.dtsi"
#include "display/dsi-panel-boe-nt35532-1080p-video.dtsi"
#include "display/dsi-panel-sharp-r63315-1080p-video.dtsi"

&soc {
	dsi_panel_pwr_supply: dsi_panel_pwr_supply {
		qcom,panel-supply-entry@0 {
			qcom,supply-name = "vddio";
			qcom,supply-min-voltage = <1800000>;
			qcom,supply-max-voltage = <1800000>;
			qcom,supply-enable-load = <100000>;
			qcom,supply-disable-load = <100>;
		};
		qcom,panel-supply-entry@1 {
			qcom,supply-name = "lab";
			qcom,supply-min-voltage = <4600000>;
			qcom,supply-max-voltage = <6000000>;
			qcom,supply-enable-load = <100000>;
			qcom,supply-disable-load = <100>;
		};

		qcom,panel-supply-entry@2 {
			qcom,supply-name = "ibb";
			qcom,supply-min-voltage = <4600000>;
			qcom,supply-max-voltage = <6000000>;
			qcom,supply-enable-load = <100000>;
			qcom,supply-disable-load = <100>;
			qcom,supply-post-on-sleep = <20>;
		};
		/delete-node/ qcom,panel-supply-entry@2;
	};
};
